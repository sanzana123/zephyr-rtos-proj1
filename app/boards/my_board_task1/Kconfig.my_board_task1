## app/boards/my_board_task1/Kconfig.my_board_task1
```kconfig
# Copyright (c) 2018 Philémon Jaermann
# SPDX-License-Identifier: Apache-2.0

config BOARD_MY_BOARD_TASK1
	select SOC_STM32F446XX if BOARD_MY_BOARD_TASK1
```

## app/boards/my_board_task1/board.yml
```yaml
board:
  name: my_board_task1
  full_name: My board copy_and_rename method
  vendor: iomico
  socs:
    - name: stm32f446xx
```

## app/boards/my_board_task2/Kconfig.my_board_task2
```kconfig
# Copyright (c) 2018 Philémon Jaermann
# SPDX-License-Identifier: Apache-2.0

config BOARD_MY_BOARD_TASK2
	select SOC_STM32F446XX if BOARD_MY_BOARD_TASK2
```

## app/boards/my_board_task2/board.yml
```yaml
board:
  name: my_board_task2
  full_name: My board from scratch method
  vendor: iomico
  socs:
    - name: stm32f446xx
```

## west.yml
```yaml
manifest:
  version: 1.0

  projects:
    - name: zephyr
      url: https://github.com/zephyrproject-rtos/zephyr
      revision: v4.2.0
      import: true
        # name-allowlist:
        #   - cmsis_6
        #   - hal_nxp
        #   - hal_stm32
        #   - hal_nordic
  self:
    path-prefix: deps
```
